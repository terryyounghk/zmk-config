// based on https://github.com/urob/zmk-config/blob/d00a9002d4606fa9fce2bcceaa4eed898ee79d4c/config/mouse.dtsi

#define ZMK_MOUSE_DEFAULT_MOVE_VAL 1500  // 600
#define ZMK_MOUSE_DEFAULT_SCRL_VAL 20    // 10

#include <dt-bindings/zmk/mouse.h>

// Config from @caksoylar, defaults in comments
&mmv {
  acceleration-exponent = <1>;      // 1
  time-to-max-speed-ms = <1000>;    // 300
  delay-ms = <0>;                   // 0
};

&msc {
  acceleration-exponent = <1>;      // 0
  time-to-max-speed-ms = <1000>;    // 300
  delay-ms = <0>;                   // 0
};

// mouse aliases
#define MV_U            MOVE_UP
#define MV_D            MOVE_DOWN
#define MV_L            MOVE_LEFT
#define MV_R            MOVE_RIGHT
#define MW_U            SCRL_UP
#define MW_D            SCRL_DOWN
#define MW_L            SCRL_LEFT
#define MW_R            SCRL_RIGHT
