// For layers without sensor bindings
#define CUSTOM_LAYER(layer_name, layer_bindings) \
/ { \
  keymap { \
    compatible = "zmk,keymap"; \
    layer_##layer_name { \
      display-name = #layer_name; \
      bindings = <layer_bindings>; \
    }; \
  }; \
};

// For layers with sensor bindings
#define CUSTOM_LAYER_WITH_SENSOR(layer_name, layer_bindings, sensor_bindings) \
/ { \
  keymap { \
    compatible = "zmk,keymap"; \
    layer_##layer_name { \
      display-name = #layer_name; \
      bindings = <layer_bindings>; \
      sensor-bindings = <sensor_bindings>; \
    }; \
  }; \
};

// Combo macros: entry
#define ADD_COMBO(enabled, keypos, combo_bindings, layer_tokens) \
    _ADD_COMBO(enabled, keypos, combo_bindings, layer_tokens, __COUNTER__)

// Combo macros: helpers
#define _ADD_COMBO(enabled, keypos, combo_bindings, layer_tokens, name) \
    _ADD_COMBO_ENABLED_##enabled(name, keypos, combo_bindings, layer_tokens)
#define _ADD_COMBO_ENABLED_1(name, keypos, combo_bindings, layer_tokens) \
    CUSTOM_COMBO(name, keypos, combo_bindings, layer_tokens)
#define _ADD_COMBO_ENABLED_0(...)

// Combo macros: dtsi
#define CUSTOM_COMBO(name, keypos, combo_bindings, layer_tokens) \
/ { \
  combos { \
    compatible = "zmk,combos"; \
    cb##name { \
      timeout-ms = <30>; \
      slow-release; \
      key-positions = <keypos>; \
      bindings = <combo_bindings>; \
      layers = <layer_tokens>; \
    }; \
  }; \
};

#define CUSTOM_MACRO(name, macro_bindings) \
/ { \
  macros { \
    name: name { \
      compatible = "zmk,behavior-macro"; \
      #binding-cells = <0>; \
      wait-ms = <40>; \
      tap-ms = <40>; \
      bindings = <macro_bindings>; \
    }; \
  }; \
};

#define TD(name, ttm, ...) \
/ { \
  behaviors { \
    td_##name: tap_dance_##name { \
      compatible = "zmk,behavior-tap-dance"; \
      #binding-cells = <0>; \
      tapping-term-ms = <ttm>; \
      bindings = __VA_ARGS__; \
    }; \
  }; \
};

#define HT(name, ttm, hold, tap) \
/ { \
  behaviors { \
    ht_##name: hold_tap_##name { \
      compatible = "zmk,behavior-hold-tap"; \
      #binding-cells = <2>; \
      flavor = "tap-preferred"; \
      tapping-term-ms = <ttm>; \
      require-prior-idle-ms = <110>; \
      bindings = hold, tap; \
    }; \
  }; \
};

#define SR(name, CW, CCW) \
/ { \
  behaviors { \
    encoder_##name: encoder_##name { \
      compatible = "zmk,behavior-sensor-rotate"; \
      #sensor-binding-cells = <0>; \
      tap-ms = <20>; \
      bindings = <CW>, <CCW>; \
    }; \
  }; \
};

#define MOD_LANY        MOD_LGUI|MOD_LSFT|MOD_LALT|MOD_LCTL
#define MOD_RANY        MOD_RGUI|MOD_RSFT|MOD_RALT|MOD_RCTL
#define MOD_ANY         MOD_LANY|MOD_RANY

#define MM(name, ON_TAP, ON_MOD) \
/ { \
  behaviors { \
    mm_##name: mm_##name { \
      compatible = "zmk,behavior-mod-morph"; \
      #binding-cells = <0>; \
      bindings = ON_TAP, ON_MOD; \
      mods = <(MOD_ANY)>; \
      keep-mods = <(MOD_ANY)>; \
    }; \
  }; \
};

// hold for momentary layer, tap to toggle a different layer
#define MT(mo, tog) &ht_mo_tog mo tog

// hold for momentary layer, tap to toggle the same layer
#define MT1(layer)  &ht_mo_tog layer layer

// hold for momentary layer, tap to go to a different layer
#define MTO(mo, to) &ht_mo_to mo to

// ------------------------------------------------------------

// TODO: implement kt_off after updating zmk
/*
/ {
    behaviors {
        kt_off: key_toggle_off_only {
            compatible = "zmk,behavior-key-toggle";
            #binding-cells = <1>;
            display-name = "Key Toggle Off";
            toggle-mode = "off";
        };
    };
};
*/

// ------------------------------------------------------------

// sticky layer
&sl {
  release-after-ms = <1500>;
  quick-release;
};

// sticky key
&sk {
  release-after-ms = <1500>;
  quick-release;
};

// layer tap
&lt {
  tapping-term-ms = <200>;
};

// caps
&caps_word {
  continue-list = <UNDERSCORE BACKSPACE DELETE MINUS DOT>;
};

// hold for a momentary layer, tap to switch to a layer
HT(mo_to, 200, <&mo>, <&to>)

// hold for a momentary layer, tap to toggle a layer
HT(mo_tog, 200, <&mo>, <&tog>)

// hold for a momentary layer, tap to toggle a layer
HT(mo_sl, 200, <&mo>, <&sl>)

// hold for a momentary layer, tap to key press
HT(mo_kp, 180, <&mo>, <&kp>)

// hold for a momentary layer, tap to set sticky key
HT(mo_sk, 180, <&mo>, <&sk>)

// For LT1: Mod-Morph
// Tap:       &key_repeat
// Mod-Morph: Mod + &kp TAB
MM(repeat, <&key_repeat>, <&kp TAB>)

/*
 * Reserved: not really good, makes it hard to do Cmd+Enter with right hand only.
// For RT1: Hold-Tap and Mod-Morph
// Tap:       &kp RETURN
// Hold:      &mo CODING
// Mod-Morph: Mod + &kp TAB
MM(enter, <&ht_mo_kp NA; RETURN>, <&kp TAB>)
*/
