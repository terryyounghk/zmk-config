#include "5_column_36_keys.h"
#include "5_column_36_keys_combos.dtsi"

/ {
  chosen {
    zmk,matrix_transform = &five_column_transform;
  };
};

CUSTOM_LAYER(qwerty, "QWERTY",
      /* ╭──────────────┬──────────────┬──────────────┬──────────────┬──────────────╮     ╭──────────────┬──────────────┬──────────────┬──────────────┬──────────────╮ */
           &kp Q          &kp W          &kp E          &kp R          &kp T                &kp Y          &kp U          &kp I          &kp O          &kp P
      /* ├──────────────┼──────────────┼──────────────┼──────────────┼──────────────┤     ├──────────────┼──────────────┼──────────────┼──────────────┼──────────────┤ */
           &kp A          &kp S          &kp D          &kp F          &kp G                &kp H          &kp J          &kp K          &kp L          &kp SEMI
      /* ├──────────────┼──────────────┼──────────────┼──────────────┼──────────────┤     ├──────────────┼──────────────┼──────────────┼──────────────┼──────────────┤ */
           &kp Z          &kp X          &kp C          &kp V          &kp B                &kp N          &kp M          &kp COMMA      &kp DOT        &kp FSLH
      /* ╰──────────────┴──────────────┴──────────────┼──────────────┼──────────────┤     ├──────────────┼──────────────┼──────────────┴──────────────┴──────────────╯ */
                                         MT(NUMBERS)    &sk LSHIFT     &krtab               &kp RETURN     &kp SPACE      &kp TAB
      /*                               ╰──────────────┴──────────────┴──────────────╯     ╰──────────────┴──────────────┴──────────────╯                               */
)

CUSTOM_LAYER(numbers, "Numbers",
      /* ╭──────────────┬──────────────┬──────────────┬──────────────┬──────────────╮     ╭──────────────┬──────────────┬──────────────┬──────────────┬──────────────╮ */
           &kp F1         &kp F2         &kp F3         &kp F4         &kp F5               &kp F6         &kp F7         &kp F8         &kp F9         &kp F10
      /* ├──────────────┼──────────────┼──────────────┼──────────────┼──────────────┤     ├──────────────┼──────────────┼──────────────┼──────────────┼──────────────┤ */
           &kp N1         &kp N2         &kp N3         &kp N4         &kp N5               &kp N6         &kp N7         &kp N8         &kp N9         &kp N0
      /* ├──────────────┼──────────────┼──────────────┼──────────────┼──────────────┤     ├──────────────┼──────────────┼──────────────┼──────────────┼──────────────┤ */
           &kp Y_YEN      &kp Y_EURO     &kp MINUS      &kp EQUAL      &kp STAR             &kp Y_POUND    &kp DOLLAR     &kp COMMA      &kp DOT        &kp FSLH
      /* ├──────────────┼──────────────┼──────────────┼──────────────┼──────────────┤     ├──────────────┼──────────────┼──────────────┼──────────────┼──────────────┤ */
                                         &trans         &trans         &trans               &trans         &trans         &trans
      /* ╰──────────────┴──────────────┴──────────────┼──────────────┼──────────────┤     ├──────────────┼──────────────┼──────────────┴──────────────┴──────────────╯ */
)

CUSTOM_LAYER(coding, "Coding",
      /* ╭──────────────┬──────────────┬──────────────┬──────────────┬──────────────╮     ╭──────────────┬──────────────┬──────────────┬──────────────┬──────────────╮ */
           &kp CARET      &kp AT         &kp LPAR       &kp RPAR       &kp DOLLAR           &kp HOME       &kp PG_DN      &kp PG_UP      &kp END        &kp PIPE
      /* ├──────────────┼──────────────┼──────────────┼──────────────┼──────────────┤     ├──────────────┼──────────────┼──────────────┼──────────────┼──────────────┤ */
           &kp APOS       &kp GRAVE      &kp LBKT       &kp RBKT       &kp STAR             &kp LEFT       &kp DOWN       &kp UP         &kp RIGHT      &kp BSLH
      /* ├──────────────┼──────────────┼──────────────┼──────────────┼──────────────┤     ├──────────────┼──────────────┼──────────────┼──────────────┼──────────────┤ */
           &kp EXCL       &kp HASH       &kp MINUS      &kp EQUAL      &kp TILDE            &kp PERCENT    &kp AMPS       &kp COMMA      &kp DOT        &kp FSLH
      /* ╰──────────────┴──────────────┴──────────────┼──────────────┼──────────────┤     ├──────────────┼──────────────┼──────────────┴──────────────┴──────────────╯ */
                                         &trans         &trans         &trans               &trans         &trans         &trans
      /*                               ╰──────────────┴──────────────┴──────────────╯     ╰──────────────┴──────────────┴──────────────╯                               */
)

CUSTOM_LAYER(controls, "Controls",
      /* ╭──────────────┬──────────────┬──────────────┬──────────────┬──────────────╮     ╭──────────────┬──────────────┬──────────────┬──────────────┬──────────────╮ */
           &kp CAPS       &kp C_PREV     &kp C_PP       &kp C_NEXT     &kp C_VOL_UP         &trans         &mkp MB4       &mmv MV_U      &mkp MB5       &trans
      /* ├──────────────┼──────────────┼──────────────┼──────────────┼──────────────┤     ├──────────────┼──────────────┼──────────────┼──────────────┼──────────────┤ */
           &bt BT_SEL 0   &bt BT_SEL 1   &bt BT_SEL 2   &bt BT_SEL 3   &kp C_VOL_DN         &msc MW_D      &mmv MV_L      &mmv MV_D      &mmv MV_R      &kp F15
      /* ├──────────────┼──────────────┼──────────────┼──────────────┼──────────────┤     ├──────────────┼──────────────┼──────────────┼──────────────┼──────────────┤ */
           &none          &none          &none          &none          &kp K_MUTE           &msc MW_U      &kp F11        &kp F12        &kp F13        &kp F14
      /* ╰──────────────┴──────────────┴──────────────┼──────────────┼──────────────┤     ├──────────────┼──────────────┼──────────────┴──────────────┴──────────────╯ */
                                         &trans         &trans         &trans               &mkp LCLK      &mkp RCLK      &mkp MCLK
      /*                               ╰──────────────┴──────────────┴──────────────╯     ╰──────────────┴──────────────┴──────────────╯                               */
)

CUSTOM_LAYER(afk, "AFK",
      /* ╭──────────────┬──────────────┬──────────────┬──────────────┬──────────────╮     ╭──────────────┬──────────────┬──────────────┬──────────────┬──────────────╮ */
           &none          &none          &none          &none          &none                &none          &none          &none          &none          &none
      /* ├──────────────┼──────────────┼──────────────┼──────────────┼──────────────┤     ├──────────────┼──────────────┼──────────────┼──────────────┼──────────────┤ */
           &none          &none          &none          &none          &none                &none          &none          &none          &none          &none
      /* ├──────────────┼──────────────┼──────────────┼──────────────┼──────────────┤     ├──────────────┼──────────────┼──────────────┼──────────────┼──────────────┤ */
           &none          &none          &none          &none          &none                &none          &none          &none          &none          &none
      /* ╰──────────────┴──────────────┴──────────────┼──────────────┼──────────────┤     ├──────────────┼──────────────┼──────────────┴──────────────┴──────────────╯ */
                                         &none          &none          &none                &none          &none          &none
      /*                               ╰──────────────┴──────────────┴──────────────╯     ╰──────────────┴──────────────┴──────────────╯                               */
)