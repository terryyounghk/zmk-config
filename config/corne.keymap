#include <behaviors/mouse_keys.dtsi>
#include <behaviors.dtsi>
#include <dt-bindings/zmk/keys.h>
#include <dt-bindings/zmk/bt.h>
#include <dt-bindings/zmk/outputs.h>

#define TY_COLUMNS 5
#include "common/base_keymap.h"
#include "common/keys.h"
#include "common/combos.h"
#include "common/mouse.dtsi"
#include "common/behaviors.dtsi"
#include "common/macros.dtsi"
#include "common/tap_dances.dtsi"

#include "common/layouts/5_column_36_keys.h"
#include "common/layouts/5_column_36_keys_thumbs.h"
#include "common/layouts/5_column_36_keys_combos.dtsi"

/ {
  chosen {
    zmk,matrix_transform = &five_column_transform;
  };
};

CUSTOM_LAYER(Qwerty,
  QWERTY_UL         QWERTY_UR
  QWERTY_HL         QWERTY_HR
  QWERTY_LL         QWERTY_LR
  QWERTY_TL         QWERTY_TR
)

CUSTOM_LAYER(Harmony,
  HARMONY_UL        HARMONY_UR
  HARMONY_HL        HARMONY_HR
  HARMONY_LL        HARMONY_LR
  HARMONY_TL        HARMONY_TR
)

CUSTOM_LAYER(Colemak,
  COLEMAK_UL        COLEMAK_UR
  COLEMAK_HL        COLEMAK_HR
  COLEMAK_LL        COLEMAK_LR
  COLEMAK_TL        COLEMAK_TR
)

CUSTOM_LAYER(Macros,
  MACROS_UL         MACROS_UR
  MACROS_HL         MACROS_HR
  MACROS_LL         MACROS_LR
  MACROS_TL         MACROS_TR
)

CUSTOM_LAYER(Numbers,
  NUMBERS_UL        NUMBERS_UR
  NUMBERS_HL        NUMBERS_HR
  NUMBERS_LL        NUMBERS_LR
  NUMBERS_TL        NUMBERS_TR
)

CUSTOM_LAYER(Numpad,
  NUMPAD_UL         NUMPAD_UR
  NUMPAD_HL         NUMPAD_HR
  NUMPAD_LL         NUMPAD_LR
  NUMPAD_TL         NUMPAD_TR
)

CUSTOM_LAYER(Symbols,
  SYMBOLS_UL        SYMBOLS_UR
  SYMBOLS_HL        SYMBOLS_HR
  SYMBOLS_LL        SYMBOLS_LR
  SYMBOLS_TL        SYMBOLS_TR
)

CUSTOM_LAYER(Coding,
  CODING_UL         CODING_UR
  CODING_HL         CODING_HR
  CODING_LL         CODING_LR
  CODING_TL         CODING_TR
)

CUSTOM_LAYER(Nav,
  NAV_UL            NAV_UR
  NAV_HL            NAV_HR
  NAV_LL            NAV_LR
  NAV_TL            NAV_TR
)

CUSTOM_LAYER(Controls,
  CONTROLS_UL       CONTROLS_UR
  CONTROLS_HL       CONTROLS_HR
  CONTROLS_LL       CONTROLS_LR
  CONTROLS_TL       CONTROLS_TR
)

CUSTOM_LAYER(Switch,
  SWITCH_UL         SWITCH_UR
  SWITCH_HL         SWITCH_HR
  SWITCH_LL         SWITCH_LR
  SWITCH_TL         SWITCH_TR
)

CUSTOM_LAYER(RetroArch,
  RETRO_UL          RETRO_UR
  RETRO_HL          RETRO_HR
  RETRO_LL          RETRO_LR
  RETRO_TL          RETRO_TR
)

CUSTOM_LAYER(Pico8,
  PICO8_UL          PICO8_UR
  PICO8_HL          PICO8_HR
  PICO8_LL          PICO8_LR
  PICO8_TL          PICO8_TR
)

CUSTOM_LAYER(Mouse,
  MOUSE_UL          MOUSE_UR
  MOUSE_HL          MOUSE_HR
  MOUSE_LL          MOUSE_LR
  MOUSE_TL          MOUSE_TR
)

CUSTOM_LAYER(Scroll,
  SCROLL_UL         SCROLL_UR
  SCROLL_HL         SCROLL_HR
  SCROLL_LL         SCROLL_LR
  SCROLL_TL         SCROLL_TR
)

CUSTOM_LAYER(Snipe,
  SNIPE_UL          SNIPE_UR
  SNIPE_HL          SNIPE_HR
  SNIPE_LL          SNIPE_LR
  SNIPE_TL          SNIPE_TR
)

CUSTOM_LAYER(AFK,
  AFK_UL            AFK_UR
  AFK_HL            AFK_HR
  AFK_LL            AFK_LR
  AFK_TL            AFK_TR
)
