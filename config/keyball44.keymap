#include <behaviors.dtsi>
#include <dt-bindings/zmk/bt.h>
#include <dt-bindings/zmk/ext_power.h>
#include <dt-bindings/zmk/keys.h>
#include <dt-bindings/zmk/outputs.h>

#define TY_COLUMNS 6
#include "common/base_keymap.h"
#include "common/keys.h"
#include "common/combos.h"
#include "common/mouse.dtsi"
#include "common/behaviors.dtsi"
#include "common/macros.dtsi"
#include "common/tap_dances.dtsi"

#include "common/layouts/keyball44_keys.h"
#include "common/layouts/keyball44_keys_thumbs.h"
#include "common/layouts/keyball44_keys_combos.dtsi"

CUSTOM_LAYER(Qwerty,
             QWERTY_6_UL       QWERTY_6_UR
             QWERTY_6_HL       QWERTY_6_HR
             QWERTY_6_LL       QWERTY_6_LR
             QWERTY_TL         QWERTY_TR
)

CUSTOM_LAYER(Harmony,
             HARMONY_6_UL      HARMONY_6_UR
             HARMONY_6_HL      HARMONY_6_HR
             HARMONY_6_LL      HARMONY_6_LR
             HARMONY_TL        HARMONY_TR
)

CUSTOM_LAYER(Colemak,
             COLEMAK_6_UL      COLEMAK_6_UR
             COLEMAK_6_HL      COLEMAK_6_HR
             COLEMAK_6_LL      COLEMAK_6_LR
             COLEMAK_TL        COLEMAK_TR
)

CUSTOM_LAYER(Macros,
             MACROS_6_UL       MACROS_6_UR
             MACROS_6_HL       MACROS_6_HR
             MACROS_6_LL       MACROS_6_LR
             MACROS_TL         MACROS_TR
)

CUSTOM_LAYER(Numbers,
             NUMBERS_6_UL      NUMBERS_6_UR
             NUMBERS_6_HL      NUMBERS_6_HR
             NUMBERS_6_LL      NUMBERS_6_LR
             NUMBERS_TL        NUMBERS_TR
)

CUSTOM_LAYER(Numpad,
             NUMPAD_6_UL      NUMPAD_6_UR
             NUMPAD_6_HL      NUMPAD_6_HR
             NUMPAD_6_LL      NUMPAD_6_LR
             NUMPAD_TL        NUMPAD_TR
)

CUSTOM_LAYER(Symbols,
             SYMBOLS_6_UL      SYMBOLS_6_UR
             SYMBOLS_6_HL      SYMBOLS_6_HR
             SYMBOLS_6_LL      SYMBOLS_6_LR
             SYMBOLS_TL        SYMBOLS_TR
)

CUSTOM_LAYER(Coding,
             CODING_6_UL       CODING_6_UR
             CODING_6_HL       CODING_6_HR
             CODING_6_LL       CODING_6_LR
             CODING_TL         CODING_TR
)

CUSTOM_LAYER(Nav,
             NAV_6_UL          NAV_6_UR
             NAV_6_HL          NAV_6_HR
             NAV_6_LL          NAV_6_LR
             NAV_TL            NAV_TR
)

CUSTOM_LAYER(Controls,
             CONTROLS_6_UL     CONTROLS_6_UR
             CONTROLS_6_HL     CONTROLS_6_HR
             CONTROLS_6_LL     CONTROLS_6_LR
             CONTROLS_TL       CONTROLS_TR
)

CUSTOM_LAYER(Switch,
             SWITCH_6_UL       SWITCH_6_UR
             SWITCH_6_HL       SWITCH_6_HR
             SWITCH_6_LL       SWITCH_6_LR
             SWITCH_TL         SWITCH_TR
)

CUSTOM_LAYER(RetroArch,
             RETRO_6_UL        RETRO_6_UR
             RETRO_6_HL        RETRO_6_HR
             RETRO_6_LL        RETRO_6_LR
             RETRO_TL          RETRO_TR
)

CUSTOM_LAYER(Pico8,
             PICO8_6_UL        PICO8_6_UR
             PICO8_6_HL        PICO8_6_HR
             PICO8_6_LL        PICO8_6_LR
             PICO8_TL          PICO8_TR
)

CUSTOM_LAYER(Mouse,
             MOUSE_6_UL        MOUSE_6_UR
             MOUSE_6_HL        MOUSE_6_HR
             MOUSE_6_LL        MOUSE_6_LR
             MOUSE_TL          MOUSE_TR
)

CUSTOM_LAYER(Scroll,
             SCROLL_6_UL       SCROLL_6_UR
             SCROLL_6_HL       SCROLL_6_HR
             SCROLL_6_LL       SCROLL_6_LR
             SCROLL_TL         SCROLL_TR
)

CUSTOM_LAYER(Snipe,
             SNIPE_6_UL        SNIPE_6_UR
             SNIPE_6_HL        SNIPE_6_HR
             SNIPE_6_LL        SNIPE_6_LR
             SNIPE_TL          SNIPE_TR
)

CUSTOM_LAYER(AFK,
             AFK_6_UL          AFK_6_UR
             AFK_6_HL          AFK_6_HR
             AFK_6_LL          AFK_6_LR
             AFK_TL            AFK_TR
)
