/*
#include <behaviors/mouse_keys.dtsi>
*/
#include <behaviors.dtsi>
#include <dt-bindings/zmk/bt.h>
#include <dt-bindings/zmk/ext_power.h>
#include <dt-bindings/zmk/keys.h>
#include <dt-bindings/zmk/mouse.h>
#include <dt-bindings/zmk/outputs.h>
#include <dt-bindings/zmk/rgb.h>

#define TY_COLUMNS 6
#include "common/base_keymap.h"
#include "common/keys.h"
#include "common/combos.h"
#include "common/mouse.dtsi"
#include "common/behaviors.dtsi"
#include "common/sensors.dtsi"
#include "common/macros.dtsi"
#include "common/tap_dances.dtsi"

#include "common/layouts/6_column_42_keys_custom.h"
#include "common/layouts/6_column_42_keys_custom_thumbs.h"
#include "common/layouts/6_column_42_keys_combos.dtsi"

/ {
  chosen {
    zmk,matrix_transform = &default_transform;
  };
};

/*
   -----------------------------------------------------------------------
   |             |                |                   |                  |
   |   ROTARY    |      LHS       |     JOYSTICK      |       RHS        |
   |             |                |                   |                  |
   -----------------------------------------------------------------------
 */

CUSTOM_LAYER_WITH_SENSOR(Qwerty,
                    QWERTY_6_UL       &mmv MOVE_UP        QWERTY_6_UR
                    QWERTY_6_HL       &mmv MOVE_DOWN      QWERTY_6_HR
                    QWERTY_6_LL       &mmv MOVE_LEFT      QWERTY_6_LR
    &kp C_MUTE      QWERTY_TL         &mmv MOVE_RIGHT     QWERTY_TR
                                      &mkp LCLK
  , &encoder_vol
)

CUSTOM_LAYER_WITH_SENSOR(Harmony,
                    HARMONY_6_UL      &mmv MOVE_UP        HARMONY_6_UR
                    HARMONY_6_HL      &mmv MOVE_DOWN      HARMONY_6_HR
                    HARMONY_6_LL      &mmv MOVE_LEFT      HARMONY_6_LR
    &kp C_MUTE      HARMONY_TL        &mmv MOVE_RIGHT     HARMONY_TR
                                      &mkp LCLK
  , &encoder_vol
)

CUSTOM_LAYER_WITH_SENSOR(Colemak,
                    COLEMAK_6_UL      &mmv MOVE_UP        COLEMAK_6_UR
                    COLEMAK_6_HL      &mmv MOVE_DOWN      COLEMAK_6_HR
                    COLEMAK_6_LL      &mmv MOVE_LEFT      COLEMAK_6_LR
    &kp C_MUTE      COLEMAK_TL        &mmv MOVE_RIGHT     COLEMAK_TR
                                      &mkp LCLK
  , &encoder_vol
)

CUSTOM_LAYER_WITH_SENSOR(Macros,
                    MACROS_6_UL       &mmv MOVE_UP        MACROS_6_UR
                    MACROS_6_HL       &mmv MOVE_DOWN      MACROS_6_HR
                    MACROS_6_LL       &mmv MOVE_LEFT      MACROS_6_LR
    &kp C_MUTE      MACROS_TL         &mmv MOVE_RIGHT     MACROS_TR
                                      &mkp LCLK
  , &encoder_vol
)

CUSTOM_LAYER_WITH_SENSOR(Numbers,
                    NUMBERS_6_UL      &mmv MOVE_UP        NUMBERS_6_UR
                    NUMBERS_6_HL      &mmv MOVE_DOWN      NUMBERS_6_HR
                    NUMBERS_6_LL      &mmv MOVE_LEFT      NUMBERS_6_LR
    &none           NUMBERS_TL        &mmv MOVE_RIGHT     NUMBERS_TR
                                      &mkp LCLK
  , &encoder_number
)

CUSTOM_LAYER_WITH_SENSOR(Numpad,
                    NUMPAD_6_UL       &mmv MOVE_UP        NUMPAD_6_UR
                    NUMPAD_6_HL       &mmv MOVE_DOWN      NUMPAD_6_HR
                    NUMPAD_6_LL       &mmv MOVE_LEFT      NUMPAD_6_LR
    &none           NUMPAD_TL         &mmv MOVE_RIGHT     NUMPAD_TR
                                      &mkp LCLK
  , &encoder_number
)

CUSTOM_LAYER_WITH_SENSOR(Symbols,
                    SYMBOLS_6_UL      &mmv MOVE_UP        SYMBOLS_6_UR
                    SYMBOLS_6_HL      &mmv MOVE_DOWN      SYMBOLS_6_HR
                    SYMBOLS_6_LL      &mmv MOVE_LEFT      SYMBOLS_6_LR
    &none           SYMBOLS_TL        &mmv MOVE_RIGHT     SYMBOLS_TR
                                      &mkp LCLK
  , &encoder_zoom
)

CUSTOM_LAYER_WITH_SENSOR(Coding,
                    CODING_6_UL       &mmv MOVE_UP        CODING_6_UR
                    CODING_6_HL       &mmv MOVE_DOWN      CODING_6_HR
                    CODING_6_LL       &mmv MOVE_LEFT      CODING_6_LR
    &none           CODING_TL         &mmv MOVE_RIGHT     CODING_TR
                                      &mkp LCLK
  , &encoder_scroll
)

CUSTOM_LAYER_WITH_SENSOR(Nav,
                    NAV_6_UL          &mmv MOVE_UP        NAV_6_UR
                    NAV_6_HL          &mmv MOVE_DOWN      NAV_6_HR
                    NAV_6_LL          &mmv MOVE_LEFT      NAV_6_LR
    &none           NAV_TL            &mmv MOVE_RIGHT     NAV_TR
                                      &mkp LCLK
  , &encoder_scroll
)

CUSTOM_LAYER_WITH_SENSOR(Controls,
                    CONTROLS_6_UL     &mmv MOVE_UP        CONTROLS_6_UR
                    CONTROLS_6_HL     &mmv MOVE_DOWN      CONTROLS_6_HR
                    CONTROLS_6_LL     &mmv MOVE_LEFT      CONTROLS_6_LR
    &none           CONTROLS_TL       &mmv MOVE_RIGHT     CONTROLS_TR
                                      &mkp LCLK
  , &encoder_scroll
)

CUSTOM_LAYER_WITH_SENSOR(Switch,
                    SWITCH_6_UL       &mmv MOVE_UP        SWITCH_6_UR
                    SWITCH_6_HL       &mmv MOVE_DOWN      SWITCH_6_HR
                    SWITCH_6_LL       &mmv MOVE_LEFT      SWITCH_6_LR
    &none           SWITCH_TL         &mmv MOVE_RIGHT     SWITCH_TR
                                      &mkp LCLK
  , &encoder_vol
)

CUSTOM_LAYER_WITH_SENSOR(RetroArch,
                    RETRO_6_UL        &mmv MOVE_UP        RETRO_6_UR
                    RETRO_6_HL        &mmv MOVE_DOWN      RETRO_6_HR
                    RETRO_6_LL        &mmv MOVE_LEFT      RETRO_6_LR
    &none           RETRO_TL          &mmv MOVE_RIGHT     RETRO_TR
                                      &mkp LCLK
  , &encoder_vol
)

CUSTOM_LAYER_WITH_SENSOR(Pico8,
                    PICO8_6_UL        &mmv MOVE_UP        PICO8_6_UR
                    PICO8_6_HL        &mmv MOVE_DOWN      PICO8_6_HR
                    PICO8_6_LL        &mmv MOVE_LEFT      PICO8_6_LR
    &none           PICO8_TL          &mmv MOVE_RIGHT     PICO8_TR
                                      &mkp LCLK
  , &encoder_vol
)

CUSTOM_LAYER_WITH_SENSOR(Mouse,
                    MOUSE_6_UL        &mmv MOVE_UP        MOUSE_6_UR
                    MOUSE_6_HL        &mmv MOVE_DOWN      MOUSE_6_HR
                    MOUSE_6_LL        &mmv MOVE_LEFT      MOUSE_6_LR
    &none           MOUSE_TL          &mmv MOVE_RIGHT     MOUSE_TR
                                      &mkp LCLK
  , &encoder_vol
)

CUSTOM_LAYER_WITH_SENSOR(Scroll,
                    SCROLL_6_UL       &mmv MOVE_UP        SCROLL_6_UR
                    SCROLL_6_HL       &mmv MOVE_DOWN      SCROLL_6_HR
                    SCROLL_6_LL       &mmv MOVE_LEFT      SCROLL_6_LR
    &none           SCROLL_TL         &mmv MOVE_RIGHT     SCROLL_TR
                                      &mkp LCLK
  , &encoder_vol
)

CUSTOM_LAYER_WITH_SENSOR(Snipe,
                    SNIPE_6_UL        &mmv MOVE_UP        SNIPE_6_UR
                    SNIPE_6_HL        &mmv MOVE_DOWN      SNIPE_6_HR
                    SNIPE_6_LL        &mmv MOVE_LEFT      SNIPE_6_LR
    &none           SWITCH_TL         &mmv MOVE_RIGHT     SWITCH_TR
                                      &mkp LCLK
  , &encoder_vol
)

CUSTOM_LAYER_WITH_SENSOR(AFK,
                    AFK_6_UL          &none               AFK_6_UR
                    AFK_6_HL          &none               AFK_6_HR
                    AFK_6_LL          &none               AFK_6_LR
    &none           AFK_TL            &none               AFK_TR
                                      &none
  , &encoder_afk
)
