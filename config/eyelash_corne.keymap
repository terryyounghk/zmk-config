/*
#include <behaviors/mouse_keys.dtsi>
*/
#include <behaviors.dtsi>
#include <dt-bindings/zmk/bt.h>
#include <dt-bindings/zmk/ext_power.h>
#include <dt-bindings/zmk/keys.h>
#include <dt-bindings/zmk/mouse.h>
#include <dt-bindings/zmk/outputs.h>
#include <dt-bindings/zmk/rgb.h>

#define TY_COLUMNS 6
#include "common/base_keymap.h"
#include "common/keys.h"
#include "common/combos.h"
#include "common/mouse.dtsi"
#include "common/behaviors.dtsi"
#include "common/sensors.dtsi"
#include "common/macros.dtsi"
#include "common/tap_dances.dtsi"

#include "common/layouts/6_column_42_keys_eyelash_corne.h"
#include "common/layouts/6_column_42_keys_eyelash_corne_thumbs.h"
#include "common/layouts/6_column_42_keys_combos.dtsi"

CUSTOM_LAYER_WITH_SENSOR(Qwerty,
  QWERTY_6_UL                              &kp UP                   QWERTY_6_UR
  QWERTY_6_HL                &kp LEFT      &kp ENTER   &kp RIGHT    QWERTY_6_HR
  QWERTY_6_LL    &kp SPACE                 &kp DOWN                 QWERTY_6_LR
  QWERTY_TL                                                         QWERTY_TR
  , &encoder_vol
)

CUSTOM_LAYER_WITH_SENSOR(Harmony,
  HARMONY_6_UL                             &kp UP                   HARMONY_6_UR
  HARMONY_6_HL               &kp LEFT      &kp ENTER   &kp RIGHT    HARMONY_6_HR
  HARMONY_6_LL   &kp SPACE                 &kp DOWN                 HARMONY_6_LR
  HARMONY_TL                                                        HARMONY_TR
  , &encoder_vol
)

CUSTOM_LAYER_WITH_SENSOR(Colemak,
  COLEMAK_6_UL                             &kp UP                   COLEMAK_6_UR
  COLEMAK_6_HL               &kp LEFT      &kp ENTER   &kp RIGHT    COLEMAK_6_HR
  COLEMAK_6_LL   &kp SPACE                 &kp DOWN                 COLEMAK_6_LR
  COLEMAK_TL                                                        COLEMAK_TR
  , &encoder_vol
)

CUSTOM_LAYER_WITH_SENSOR(Macros,
  MACROS_6_UL                              &kp UP                   MACROS_6_UR
  MACROS_6_HL                &kp LEFT      &kp ENTER   &kp RIGHT    MACROS_6_HR
  MACROS_6_LL    &kp SPACE                 &kp DOWN                 MACROS_6_LR
  MACROS_TL                                                         MACROS_TR
  , &encoder_vol
)

CUSTOM_LAYER_WITH_SENSOR(Numbers,
  NUMBERS_6_UL                             &kp UP                   NUMBERS_6_UR
  NUMBERS_6_HL               &kp LEFT      &kp ENTER   &kp RIGHT    NUMBERS_6_HR
  NUMBERS_6_LL   &kp SPACE                 &kp DOWN                 NUMBERS_6_LR
  NUMBERS_TL                                                        NUMBERS_TR
  , &encoder_vol
)

CUSTOM_LAYER_WITH_SENSOR(Numpad,
  NUMPAD_6_UL                              &kp UP                   NUMPAD_6_UR
  NUMPAD_6_HL                &kp LEFT      &kp ENTER   &kp RIGHT    NUMPAD_6_HR
  NUMPAD_6_LL    &kp SPACE                 &kp DOWN                 NUMPAD_6_LR
  NUMPAD_TL                                                         NUMPAD_TR
  , &encoder_vol
)

CUSTOM_LAYER_WITH_SENSOR(Symbols,
  SYMBOLS_6_UL                             &kp UP                   SYMBOLS_6_UR
  SYMBOLS_6_HL               &kp LEFT      &kp ENTER   &kp RIGHT    SYMBOLS_6_HR
  SYMBOLS_6_LL   &kp SPACE                 &kp DOWN                 SYMBOLS_6_LR
  SYMBOLS_TL                                                        SYMBOLS_TR
  , &encoder_vol
)

CUSTOM_LAYER_WITH_SENSOR(Coding,
  CODING_6_UL                              &kp UP                   CODING_6_UR
  CODING_6_HL                &kp LEFT      &kp ENTER   &kp RIGHT    CODING_6_HR
  CODING_6_LL    &kp SPACE                 &kp DOWN                 CODING_6_LR
  CODING_TL                                                         CODING_TR
  , &encoder_vol
)

CUSTOM_LAYER_WITH_SENSOR(Nav,
  NAV_6_UL                                 &kp UP                   NAV_6_UR
  NAV_6_HL                   &kp LEFT      &kp ENTER   &kp RIGHT    NAV_6_HR
  NAV_6_LL       &kp SPACE                 &kp DOWN                 NAV_6_LR
  NAV_TL                                                            NAV_TR
  , &encoder_vol
)

CUSTOM_LAYER_WITH_SENSOR(Controls,
  CONTROLS_6_UL                            &kp UP                   CONTROLS_6_UR
  CONTROLS_6_HL              &kp LEFT      &kp ENTER   &kp RIGHT    CONTROLS_6_HR
  CONTROLS_6_LL  &kp SPACE                 &kp DOWN                 CONTROLS_6_LR
  CONTROLS_TL                                                       CONTROLS_TR
  , &encoder_vol
)

CUSTOM_LAYER_WITH_SENSOR(Switch,
  SWITCH_6_UL                              &kp UP                   SWITCH_6_UR
  SWITCH_6_HL                &kp LEFT      &kp ENTER   &kp RIGHT    SWITCH_6_HR
  SWITCH_6_LL    &kp SPACE                 &kp DOWN                 SWITCH_6_LR
  SWITCH_TL                                                         SWITCH_TR
  , &encoder_vol
)

CUSTOM_LAYER_WITH_SENSOR(RetroArch,
  RETRO_6_UL                               &kp UP                   RETRO_6_UR
  RETRO_6_HL                 &kp LEFT      &kp ENTER   &kp RIGHT    RETRO_6_HR
  RETRO_6_LL     &kp SPACE                 &kp DOWN                 RETRO_6_LR
  RETRO_TL                                                          RETRO_TR
  , &encoder_vol
)

CUSTOM_LAYER_WITH_SENSOR(Pico8,
  PICO8_6_UL                               &kp UP                   PICO8_6_UR
  PICO8_6_HL                 &kp LEFT      &kp ENTER   &kp RIGHT    PICO8_6_HR
  PICO8_6_LL     &kp SPACE                 &kp DOWN                 PICO8_6_LR
  PICO8_TL                                                          PICO8_TR
  , &encoder_vol
)

CUSTOM_LAYER_WITH_SENSOR(Mouse,
  MOUSE_6_UL                              &kp UP                   MOUSE_6_UR
  MOUSE_6_HL                &kp LEFT      &kp ENTER   &kp RIGHT    MOUSE_6_HR
  MOUSE_6_LL    &kp SPACE                 &kp DOWN                 MOUSE_6_LR
  MOUSE_TL                                                         MOUSE_TR
  , &encoder_vol
)

CUSTOM_LAYER_WITH_SENSOR(Scroll,
  SCROLL_6_UL                              &kp UP                   SCROLL_6_UR
  SCROLL_6_HL                &kp LEFT      &kp ENTER   &kp RIGHT    SCROLL_6_HR
  SCROLL_6_LL    &kp SPACE                 &kp DOWN                 SCROLL_6_LR
  SCROLL_TL                                                         SCROLL_TR
  , &encoder_vol
)

CUSTOM_LAYER_WITH_SENSOR(Snipe,
  SNIPE_6_UL                              &kp UP                   SNIPE_6_UR
  SNIPE_6_HL                &kp LEFT      &kp ENTER   &kp RIGHT    SNIPE_6_HR
  SNIPE_6_LL    &kp SPACE                 &kp DOWN                 SNIPE_6_LR
  SNIPE_TL                                                         SNIPE_TR
  , &encoder_vol
)

CUSTOM_LAYER_WITH_SENSOR(AFK,
  AFK_6_UL                                 &none                    AFK_6_UR
  AFK_6_HL                   &none         &none       &none        AFK_6_HR
  AFK_6_LL       &none                     &none                    AFK_6_LR
  AFK_TL                                                            AFK_TR
  , &encoder_vol
)
