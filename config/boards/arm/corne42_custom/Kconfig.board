## config/boards/arm/corne42_custom/Kconfig.board
```kconfig
#
# Copyright (c) 2022 Darryl deHaan
# SPDX-License-Identifier: MIT
#

config BOARD_CORNE42_CUSTOM_LEFT
    bool "corne42_custom left"
    depends on SOC_NRF52840_QIAA


config BOARD_CORNE42_CUSTOM_RIGHT
    bool "corne42_custom right"
    depends on SOC_NRF52840_QIAA
```

## config/west.yml
```yaml
manifest:
  remotes:
    - name: zmkfirmware
      url-base: https://github.com/zmkfirmware
    - name: urob
      url-base: https://github.com/urob
    - name: terryyounghk
      url-base: https://github.com/terryyounghk
  projects:
    - name: zmk
      remote: urob
      revision: main
      import: app/west.yml
#   - name: zmk
#     remote: zmkfirmware
#     revision: feat/pointers-move-scroll
#     import: app/west.yml
    - name: zmk-pmw3610-driver
      remote: terryyounghk
      revision: main
#   - name: zmk-helpers
#     remote: urob
#     revision: main
    - name: eyelash_corne
      url: https://github.com/a741725193/zmk-new_corne
      revision: main
  self:
    path: config
```
